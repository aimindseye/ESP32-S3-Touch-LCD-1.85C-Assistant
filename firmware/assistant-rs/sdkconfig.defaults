## firmware/assistant-rs/sdkconfig.defaults
```kconfig
CONFIG_SPIRAM=y
CONFIG_SPIRAM_BOOT_INIT=y
CONFIG_SPIRAM_MODE_OCT=y
CONFIG_SPIRAM_TYPE_AUTO=y
CONFIG_SPIRAM_SPEED_80M=y
CONFIG_SPIRAM_USE_MALLOC=y
CONFIG_SPIRAM_MALLOC_ALWAYSINTERNAL=4096
CONFIG_SPIRAM_MALLOC_RESERVE_INTERNAL=65536
CONFIG_SPIRAM_TRY_ALLOCATE_WIFI_LWIP=y
CONFIG_SPIRAM_ALLOW_BSS_SEG_EXTERNAL_MEMORY=y
CONFIG_FATFS_ALLOC_PREFER_EXTRAM=y
CONFIG_ESP_MAIN_TASK_STACK_SIZE=8192

CONFIG_ESPTOOLPY_FLASHSIZE_16MB=y
CONFIG_ESPTOOLPY_FLASHSIZE="16MB"
CONFIG_PARTITION_TABLE_CUSTOM=y
CONFIG_PARTITION_TABLE_CUSTOM_FILENAME="/Users/piyushdaiya/Documents/projects/ESP32-S3-Touch-LCD-1.85C-Assistant/firmware/assistant-rs/partitions.csv"
CONFIG_PARTITION_TABLE_FILENAME="/Users/piyushdaiya/Documents/projects/ESP32-S3-Touch-LCD-1.85C-Assistant/firmware/assistant-rs/partitions.csv"
CONFIG_PARTITION_TABLE_OFFSET=0x8000
CONFIG_MBEDTLS_CERTIFICATE_BUNDLE=y
CONFIG_MBEDTLS_CERTIFICATE_BUNDLE_DEFAULT_CMN=y
# CONFIG_MBEDTLS_CERTIFICATE_BUNDLE_DEPRECATED_LIST is not set

# RAW-V1-0-1-R1-LOCAL-PARTITION-PATH-REPAIR
```
